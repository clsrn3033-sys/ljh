## buildroot/package/mebs/Config.in
```kconfig
config BR2_PACKAGE_MEBS
	bool "mebs"
	depends on BR2_USE_MMU
	depends on BR2_USE_WCHAR
	depends on BR2_TOOLCHAIN_HAS_THREADS
	depends on !BR2_STATIC_LIBS
	select BR2_PACKAGE_PYTHON3
	select BR2_PACKAGE_UTIL_LINUX
	select BR2_PACKAGE_UTIL_LINUX_BINARIES
	help
	  MEBS directory backup engine and read-only USB observer.
	  Automatic mounting, formatting and shutdown are not enabled.

config BR2_PACKAGE_MEBS_DISPLAY
	bool "MEBS display renderer and offline preview"
	depends on BR2_PACKAGE_MEBS
	depends on BR2_INSTALL_LIBSTDCPP
	select BR2_PACKAGE_PYTHON_PILLOW
	select BR2_PACKAGE_FREETYPE
	help
	  Optional PNG renderer and Linux framebuffer display demo.
	  A Korean TTF/TTC/OTF font must be supplied separately and
	  selected using MEBS_FONT. Does not enable automatic backup.

config BR2_PACKAGE_MEBS_CONTROLS
    bool "MEBS optional 800x480 touch controls / direct KMS"
    depends on BR2_PACKAGE_MEBS_DISPLAY
    select BR2_PACKAGE_LIBDRM
    help
      Additive display-independent backup worker, sensor and settings runtime.
      Only the separate DSI test board profile starts this runtime by default.
      Requires a verified panel configuration before enabling live DSI output.
```
